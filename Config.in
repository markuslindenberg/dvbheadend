## Config.in
```kconfig
source "$BR2_EXTERNAL_DVBHEADEND_PATH/package/node_exporter/Config.in"
source "$BR2_EXTERNAL_DVBHEADEND_PATH/package/oscam/Config.in"
```

## configs/dvbheadend_raspberrypi4_64_defconfig
```kconfig
BR2_aarch64=y
BR2_cortex_a72=y
BR2_ARM_FPU_VFPV4=y
BR2_OPTIMIZE_FAST=y
BR2_TOOLCHAIN_BUILDROOT_GLIBC=y
BR2_TARGET_GENERIC_HOSTNAME="dvbheadend"
BR2_TARGET_GENERIC_ISSUE="github.com/markuslindenberg/dvbheadend"
BR2_INIT_SYSTEMD=y
BR2_TARGET_GENERIC_GETTY_PORT="tty1"
BR2_ENABLE_LOCALE_WHITELIST="C en_US de_DE"
BR2_ROOTFS_USERS_TABLES="$(BR2_EXTERNAL_DVBHEADEND_PATH)/board/common/users"
BR2_ROOTFS_OVERLAY="$(BR2_EXTERNAL_DVBHEADEND_PATH)/board/common/rootfs-overlay"
BR2_ROOTFS_POST_BUILD_SCRIPT="$(BR2_EXTERNAL_DVBHEADEND_PATH)/board/common/post-build.sh"
BR2_ROOTFS_POST_IMAGE_SCRIPT="$(BR2_EXTERNAL_DVBHEADEND_PATH)/board/raspberrypi4-64/post-image.sh"
BR2_LINUX_KERNEL=y
BR2_LINUX_KERNEL_CUSTOM_TARBALL=y
BR2_LINUX_KERNEL_CUSTOM_TARBALL_LOCATION="$(call github,raspberrypi,linux,ef04c31043ed31f3dbe6697ba38e026280a852b9)/linux-ef04c31043ed31f3dbe6697ba38e026280a852b9.tar.gz"
BR2_LINUX_KERNEL_DEFCONFIG="bcm2711"
BR2_LINUX_KERNEL_CONFIG_FRAGMENT_FILES="$(BR2_EXTERNAL_DVBHEADEND_PATH)/board/raspberrypi4-64/kernel-raspberrypi3-64.config"
BR2_LINUX_KERNEL_DTS_SUPPORT=y
BR2_LINUX_KERNEL_INTREE_DTS_NAME="broadcom/bcm2711-rpi-4-b"
BR2_LINUX_KERNEL_DTB_OVERLAY_SUPPORT=y
BR2_LINUX_KERNEL_NEEDS_HOST_OPENSSL=y
BR2_PACKAGE_BUSYBOX_CONFIG_FRAGMENT_FILES="$(BR2_EXTERNAL_DVBHEADEND_PATH)/board/common/busybox.config"
BR2_PACKAGE_F2FS_TOOLS=y
BR2_PACKAGE_LINUX_FIRMWARE=y
BR2_PACKAGE_LINUX_FIRMWARE_AS102=y
BR2_PACKAGE_LINUX_FIRMWARE_DIB0700=y
BR2_PACKAGE_LINUX_FIRMWARE_ITETECH_IT9135=y
BR2_PACKAGE_LINUX_FIRMWARE_H5_DRXK=y
BR2_PACKAGE_LINUX_FIRMWARE_XCx000=y
BR2_PACKAGE_RPI_FIRMWARE=y
BR2_PACKAGE_RPI_FIRMWARE_VARIANT_PI4=y
BR2_PACKAGE_RPI_WIFI_FIRMWARE=y
BR2_PACKAGE_PARTED=y
BR2_PACKAGE_RNG_TOOLS=y
BR2_PACKAGE_CA_CERTIFICATES=y
BR2_PACKAGE_LIBDVBCSA=y
BR2_PACKAGE_LIBHDHOMERUN=y
BR2_PACKAGE_LIBURIPARSER=y
BR2_PACKAGE_NSS_MDNS=y
BR2_PACKAGE_LINUX_PAM=y
BR2_PACKAGE_READLINE=y
BR2_PACKAGE_AVAHI=y
# BR2_PACKAGE_AVAHI_AUTOIPD is not set
BR2_PACKAGE_AVAHI_DAEMON=y
BR2_PACKAGE_IW=y
BR2_PACKAGE_IWD=y
BR2_PACKAGE_OPENSSH=y
BR2_PACKAGE_TVHEADEND=y
BR2_PACKAGE_WIRELESS_REGDB=y
BR2_PACKAGE_HTOP=y
# BR2_PACKAGE_SYSTEMD_PSTORE is not set
# BR2_PACKAGE_SYSTEMD_HWDB is not set
BR2_PACKAGE_SYSTEMD_LOGIND=y
BR2_PACKAGE_SYSTEMD_SYSUSERS=y
BR2_TARGET_ROOTFS_INITRAMFS=y
# BR2_TARGET_ROOTFS_TAR is not set
BR2_PACKAGE_HOST_DOSFSTOOLS=y
BR2_PACKAGE_HOST_F2FS_TOOLS=y
BR2_PACKAGE_HOST_GENIMAGE=y
BR2_PACKAGE_HOST_MTOOLS=y
BR2_PACKAGE_NODE_EXPORTER=y
BR2_PACKAGE_MN88472_FIRMWARE=y
```

## package/mn88472-firmware/Config.in
```kconfig
config BR2_PACKAGE_MN88472_FIRMWARE
	bool "mn88472-firmware"
	help
	  Firmware for Panasonic MN88472 DVB-T/DVB-T2/DVB-C demodulator

	  https://www.linuxtv.org/wiki/index.php/Xbox_One_Digital_TV_Tuner
```

## package/node_exporter/Config.in
```kconfig
config BR2_PACKAGE_NODE_EXPORTER
	bool "node_exporter"
	depends on BR2_PACKAGE_HOST_GO_TARGET_ARCH_SUPPORTS
	help
	  Exporter for machine metrics

	  https://github.com/prometheus/node_exporter/
```

## package/oscam/Config.in
```kconfig
config BR2_PACKAGE_OSCAM
	bool "oscam"
	select BR2_PACKAGE_OPENSSL
	help
	  OSCam is an Open Source Conditional Access Module software,
	  based on the very good MpCS version 0.9d created by dukat.

	  https://trac.streamboard.tv/oscam/wiki
```
